## backport/dsm/Kconfig
```kconfig
config DRM_BACKPORT
	bool
	default y

config AUXILIARY_BUS_BACKPORT
	tristate
	default m if AUXILIARY_BUS != y && AUXILIARY_BUS != m

config GPU_BUDDY
	tristate
	default m

config VIDEO
	bool
	default y

config FB_CORE
	tristate
	default FB

config FB_IOMEM_HELPERS
	bool
	default y

config DMABUF_BACKPORT
	tristate
	default m

config DMABUF_MOVE_NOTIFY
	bool
	default y

config SYNC_FILE
	bool
	default y

config HDMI_BACKPORT
	tristate
	default m if HDMI != y && HDMI != m

config INTEL_GTT_BACKPORT
	tristate
	default m if INTEL_GTT != y && INTEL_GTT != m

config DRM_MIPI_DSI_BACKPORT
	tristate
	default m if DRM_MIPI_DSI != y && DRM_MIPI_DSI != m

config I2C_ALGOBIT_BACKPORT
	tristate
	default m if I2C_ALGOBIT != y && I2C_ALGOBIT != m
```

## backport/dsm/Kconfig.sources
```kconfig
source "$BACKPORT_DIR/compat/Kconfig"
source "$BACKPORT_DIR/dsm/Kconfig"
source "$BACKPORT_DIR/drivers/gpu/drm/Kconfig"
```
